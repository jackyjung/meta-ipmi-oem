## conf/layer.conf
```bitbake
# meta-ves layer configuration

BBPATH .= ":${LAYERDIR}"

BBFILES += "${LAYERDIR}/recipes-*/*/*/*.bb \
            ${LAYERDIR}/recipes-*/*/*.bbappend"

BBFILE_PATTERN_meta-ves := "^${LAYERDIR}/"
BBFILE_COLLECTIONS += "meta-ves"
BBFILE_PATTERN_meta-ves := "^${LAYERDIR}/"
BBFILE_PRIORITY_meta-ves = "9"
LAYERSERIES_COMPAT_meta-ves = "nanbield"
```
